## devices/ina226_power_monitor/sdkconfig.defaults
```kconfig
# Rust main task stack
CONFIG_ESP_MAIN_TASK_STACK_SIZE=8192

# Use USB Serial/JTAG console on XIAO ESP32S3
CONFIG_ESP_CONSOLE_USB_SERIAL_JTAG=y
CONFIG_ESP_CONSOLE_SECONDARY_NONE=y

# Keep logging readable while measuring
CONFIG_LOG_DEFAULT_LEVEL_INFO=y
CONFIG_LOG_DEFAULT_LEVEL=3
CONFIG_LOG_MAXIMUM_LEVEL=3

# Increase default pthread stack (Rust std::thread uses pthread task)
CONFIG_PTHREAD_TASK_STACK_SIZE_DEFAULT=12288

# Flash size: 8MB (matches the actual module)
CONFIG_ESPTOOLPY_FLASHSIZE_8MB=y

# Use large single-app partition (3MB)
CONFIG_PARTITION_TABLE_SINGLE_APP_LARGE=y
```

## devices/xiao_esp32s3_sense/sdkconfig.defaults
```kconfig
# Rust often needs a bit of an extra main task stack size compared to C (the default is 3K)
CONFIG_ESP_MAIN_TASK_STACK_SIZE=16000

# enable PSRAM for esp32s3
CONFIG_SPIRAM=y
CONFIG_SPIRAM_MODE_OCT=y
CONFIG_SPIRAM_SPEED_80M=y

# ESP-NOW and WiFi memory optimization
CONFIG_ESP_WIFI_DYNAMIC_RX_BUFFER_NUM=64
CONFIG_ESP_WIFI_DYNAMIC_TX_BUFFER_NUM=64
CONFIG_ESP_WIFI_STATIC_RX_BUFFER_NUM=16
CONFIG_ESP_WIFI_TX_BUFFER_TYPE=1

# Power Save Configuration
# CPU Frequency: 160MHz(default) -> 80MHz
# ベース電力消費を削減し、カメラ画像にノイズが乗らないようにする
CONFIG_ESP32S3_DEFAULT_CPU_FREQ_80=y
CONFIG_ESP32S3_DEFAULT_CPU_FREQ_MHZ=80

# USB Serial/JTAG Console settings
CONFIG_ESP_CONSOLE_USB_SERIAL_JTAG=y
CONFIG_ESP_CONSOLE_SECONDARY_NONE=y

# Light Sleep related settings
CONFIG_FREERTOS_USE_TICKLESS_IDLE=y
CONFIG_PM_ENABLE=y
CONFIG_PM_DFS_INIT_AUTO=y

# Disable all logging
CONFIG_LOG_DEFAULT_LEVEL_NONE=y
CONFIG_LOG_DEFAULT_LEVEL=0
CONFIG_LOG_MAXIMUM_LEVEL=0
```

## devices/xiao_esp32s3_temp_sensor/sdkconfig.defaults
```kconfig
# WiFi スタック含む余裕を確保
CONFIG_ESP_MAIN_TASK_STACK_SIZE=16000

# XIAO ESP32-S3 は USB Serial/JTAG 経由でログ出力 (UART チップ非搭載)
CONFIG_ESP_CONSOLE_USB_SERIAL_JTAG=y
CONFIG_ESP_CONSOLE_SECONDARY_NONE=y

# PHY キャリブレーション結果を NVS に保存し Deep Sleep 復帰時のフルキャリブレーションをスキップ
# → 起動時間を約 100ms 短縮、消費電流を約 35 mAs 削減
# 定期的な強制再キャリブレーションは recalibration_interval (cfg.toml) で制御
CONFIG_ESP_PHY_CALIBRATION_AND_DATA_STORAGE=y
```
